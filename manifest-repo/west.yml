## manifest-repo/west.yml
```yaml
manifest:
  remotes:
    - name: zephyrproject-rtos
      url-base: https://github.com/zephyrproject-rtos
    - name: cweave72
      url-base: https://github.com/cweave72
    - name: nanopb
      url-base: https://github.com/nanopb
  projects:
    - name: zephyr-applications
      remote: cweave72
      revision: main
      path: applications
    - name: zephyr-common
      remote: cweave72
      revision: main
      path: common
    - name: zephyr-proto
      remote: cweave72
      revision: main
      path: proto
    - name: zephyr-python
      remote: cweave72
      revision: main
      path: python
    - name: nanopb
      remote: nanopb
      revision: nanopb-0.4.9
      path: deps/optional/nanopb
    - name: zephyr
      remote: zephyrproject-rtos
      revision: v4.0.0
      import:
        path-prefix: deps
        name-allowlist:
          - cmsis
          - hal_espressif
          - hal_stm32
          - mbedtls
          - mcuboot
          - net-tools
          - littlefs
  self:
    path: manifest-repo
```
